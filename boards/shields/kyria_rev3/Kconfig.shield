## boards/shields/kyria_rev3/Kconfig.shield
```kconfig
config SHIELD_KYRIA_LEFT
    def_bool $(shields_list_contains,kyria_rev3_left)

config SHIELD_KYRIA_RIGHT
    def_bool $(shields_list_contains,kyria_rev3_right)
```
